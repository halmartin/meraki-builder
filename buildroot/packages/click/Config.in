## buildroot/packages/click/Config.in
```kconfig
config BR2_PACKAGE_CLICK
    bool "click"
    depends on BR2_INSTALL_LIBSTDCPP
    select BR2_PACKAGE_OPENSSL
    select BR2_PACKAGE_LIBPCAP
    select BR2_PACKAGE_LIBBACKTRACE
    help
      Click is a modular router toolkit.
```

## buildroot/packages/clickswstatus/Config.in
```kconfig
config BR2_PACKAGE_STATUS
bool "clickswstatus"
help
The clickswstatus utility is used to read the switch's status
select BR2_PACKAGE_JSON_C
```

## buildroot/packages/configd/Config.in
```kconfig
config BR2_PACKAGE_CONFIGD
bool "configd"
help
The configd utility is used to read/write the switch's config
select BR2_PACKAGE_JSON_C
```

## buildroot/packages/find_hdr/Config.in
```kconfig
config BR2_PACKAGE_FINDHDR
bool "findhdr"
help
The findhdr utility is used to locate the offset of the embedded ramdisk in various Meraki switch firmwares.
```

## buildroot/packages/pd690xx/Config.in
```kconfig
config BR2_PACKAGE_PD690XX
bool "pd690xx"
help
The pd690xx utility is used to manage the Microsemi PD690xx series of PoE power management chips
```

## buildroot/packages/status/Config.in
```kconfig
config BR2_PACKAGE_STATUS
bool "status"
help
The status utility is used to read the switch's status
select BR2_PACKAGE_JSON_C
```
